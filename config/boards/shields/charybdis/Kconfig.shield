## config/boards/shields/charybdis/Kconfig.shield
```kconfig
config SHIELD_CHARYBDIS_LEFT
    def_bool $(shields_list_contains,charybdis_left)

config SHIELD_CHARYBDIS_RIGHT
    def_bool $(shields_list_contains,charybdis_right)

config GC9A01A                                                                                                       
    def_bool y    
```

## config/west.yml
```yaml
manifest:                                                                                                            
  self:                                                                                                              
    path: zmk                                                                                                        
  remotes:                                                                                                           
    - name: zmkfirmware                                                                                              
      url-base: https://github.com/DoctorWangWang                                                                    
  projects:                                                                                                          
    - name: zmk                                                                                                      
      remote: zmkfirmware                                                                                            
      revision: feature-test                                                                                         
      import: app/west.yml                                                                                           
    - name: gc9a01a_zephyr_driver
      url: https://github.com/wzb841014/gc9a01a_zephyr_driver
      revision: main           
```
